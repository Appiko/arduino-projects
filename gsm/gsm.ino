
/**************************************************************

   This sketch connects to a website and downloads a page.
   It can be used to perform HTTP/RESTful API calls.

   For this example, you need to install ArduinoHttpClient library:
     https://github.com/arduino-libraries/ArduinoHttpClient
     or from http://librarymanager/all#ArduinoHttpClient

   TinyGSM Getting Started guide:
     https://tiny.cc/tinygsm-readme

   For more HTTP API examples, see ArduinoHttpClient library

   NOTE: This example may NOT work with the XBee because the
   HttpClient library does not empty to serial buffer fast enough
   and the buffer overflow causes the HttpClient library to stall.
   Boards with faster processors may work, 8MHz boards will not.
 **************************************************************/
#include <ip.h>

// Select your modem:
#define TINY_GSM_MODEM_SIM800

// Increase RX buffer to capture the entire response
// Chips without internal buffering (A6/A7, ESP8266, M590)
// need enough space in the buffer for the entire response
// else data will be lost (and the http library will fail).
#define TINY_GSM_RX_BUFFER 650

// See all AT commands, if wanted
//#define DUMP_AT_COMMANDS

// Define the serial console for debug prints, if needed
//#define TINY_GSM_DEBUG Serial
//#define LOGGING  // <- Logging is for the HTTP library

// Add a reception delay, if needed
//#define TINY_GSM_YIELD() { delay(1); }

// Set serial for debug console (to the Serial Monitor, default speed 115200)
#define SerialMon Serial

// Set serial for AT commands (to the module)
// Use Hardware Serial on Mega, Leonardo, Micro
#define SerialAT Serial1

// or Software Serial on Uno, Nano
//#include <SoftwareSerial.h>
//SoftwareSerial SerialAT(2, 3); // RX, TX

#define TINY_GSM_USE_GPRS true
#define TINY_GSM_USE_WIFI false

// set GSM PIN, if any
#define GSM_PIN ""

// Your GPRS credentials
// Leave empty, if missing user or pass
const char apn[]  = "bsnlnet";
const char gprsUser[] = "";
const char gprsPass[] = "";

// Server details
const char server[] = IP;
//char resource[] = "/image";
const int  port = 3200;

//const char data[] = {0x89, 0x50, 0x4E, 0x47, 0x0D, 0x0A, 0x1A, 0x0A, 0x00, 0x00, 0x00, 0x0D, 0x49,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 0x60, 0x82};
//const char data[] = {0x89, 0x50, 0x4E, 0x47, 0x0D, 0x0A, 0x1A, 0x0A, 0x00, 0x00, 0x00, 0x0D, 0x49,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 0x60, 0x82};
//const char data[] = {0x89, 0x50, 0x4E, 0x47, 0x0D, 0x0A, 0x1A, 0x0A, 0x00, 0x00, 0x00, 0x0D, 0x49,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 0x60, 0x82};
#include <TinyGsmClient.h>
#include <ArduinoHttpClient.h>

#ifdef DUMP_AT_COMMANDS
#include <StreamDebugger.h>
StreamDebugger debugger(SerialAT, SerialMon);
TinyGsm modem(debugger);
#else
TinyGsm modem(SerialAT);
#endif

TinyGsmClient client(modem);
HttpClient http(client, server, port);

void setup() {


  // Set console baud rate
  SerialMon.begin(115200);
  Serial2.begin(115200);

  delay(10);

  // Set your reset, enable, power pins here
  pinMode(20, OUTPUT);
  digitalWrite(20, HIGH);

  pinMode(23, OUTPUT);
  digitalWrite(23, HIGH);

  SerialMon.println("Wait...");

  // Set GSM module baud rate
  SerialAT.begin(115200);
  delay(3000);

  // Restart takes quite some time
  // To skip it, call init() instead of restart()
  SerialMon.println("Initializing modem...");
  modem.restart();
  // modem.init();



  String modemInfo = modem.getModemInfo();
  SerialMon.print("Modem: ");
  SerialMon.println(modemInfo);

  // Unlock your SIM card with a PIN
  //modem.simUnlock("1234");
  //  conn();
  //  makeReq("/alert");

}

void loop() {
  conn();
  makeReq("/alert?q=A");

  while (true) {

    if (Serial2.available() > 0) {
      char incomingByte = Serial2.read();
      int x = incomingByte;
      SerialMon.print(x);
      if (incomingByte != 10) {
        SerialMon.print("I received: ");
        SerialMon.println(incomingByte);
        String resource = "/alert?q=" + String(incomingByte);
        SerialMon.print(resource);
        makeReq(resource);
      }
    }
  }
  delay(500);
}

void disconnGPRS() {
  modem.gprsDisconnect();
  SerialMon.println(F("GPRS disconnected"));
}

void makeReq(String resource) {
  connGPRS();

  SerialMon.print(F("Performing HTTP GET request... "));
    int err = http.get(resource);
    SerialMon.print(err);
    if (err != 0) {
      SerialMon.println(F("failed to connect"));
      delay(1000);
      disconn();
      return;
    }
//  http.setTimeout(600);
//  http.beginRequest();
//  int err = http.post("/image/data.png");
//  if (err != 0) {
//    SerialMon.println(F("FAIL"));
//    delay(1000);
//    disconn();
//    return;
//  } else {
//    SerialMon.println(F("GOOD"));
//  }
//
//  //  SerialMon.println(data);
//
//  http.sendHeader(F("Content-Type"), F("image/png"));
//  http.sendHeader(F("Connection"), F("Keep-Alive"));
//  http.sendHeader(F("Keep-Alive"), F("timeout=120, max=1000"));
//  http.sendHeader(F("Content-Length"), "82");
//  http.sendHeader(F("Content-Transfer-Encoding"), F("binary"));
//
//  http.beginBody();
//  for (int i = 0; i < 82; i++) {
//    http.print(data[i]);
//  }
//  http.println("");
//  http.endRequest();

  int status = http.responseStatusCode();
  SerialMon.print(F("Response status code: "));
  SerialMon.println(status);
  if (!status || status < 0) {
    delay(1000);
    disconn();
    return;
  }

  SerialMon.println(F("Response Headers:"));
  while (http.headerAvailable()) {
    String headerName = http.readHeaderName();
    String headerValue = http.readHeaderValue();
    SerialMon.println("    " + headerName + " : " + headerValue);
  }

  int length = http.contentLength();
  if (length >= 0) {
    SerialMon.print(F("Content length is: "));
    SerialMon.println(length);
  }
  if (http.isResponseChunked()) {
    SerialMon.println(F("The response is chunked"));
  }

  String body = http.responseBody();
  SerialMon.println(F("Response:"));
  SerialMon.println(body);

  SerialMon.print(F("Body length is: "));
  SerialMon.println(body.length());

  disconn();

}
void disconn() {
  // Shutdown

  http.stop();
  SerialMon.println(F("Server disconnected"));

  disconnGPRS();

}
void conn() {
  SerialMon.print("Waiting for network...");
  if (!modem.waitForNetwork()) {
    SerialMon.println(" fail");
    delay(10000);
    return;
  }
  SerialMon.println(" OK");

  if (modem.isNetworkConnected()) {
    SerialMon.println("Network connected");
  }

}

void connGPRS() {
  SerialMon.print(F("Connecting to "));
  SerialMon.print(apn);
  if (!modem.gprsConnect(apn, gprsUser, gprsPass)) {
    SerialMon.println(" fail");
    delay(10000);
    return;
  }
  SerialMon.println(" OK");
}
